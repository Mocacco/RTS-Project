## password_manager/sdkconfig.defaults
```kconfig
# Console via USB CDC - Manter apenas para S2 e S3
CONFIG_TINYUSB_DEVICE_ENABLED=y
CONFIG_TINYUSB_DESC_USE_ESPRESSIF_VID_PID=y

# Flash = 4MB
CONFIG_ESPTOOLPY_FLASHSIZE_4MB=y
CONFIG_ESPTOOLPY_FLASHSIZE="4MB"

# CPU = 240 MHz - Manter apenas para o modelo usado
CONFIG_ESP32_DEFAULT_CPU_FREQ_MHZ=240
CONFIG_ESP32_DEFAULT_CPU_FREQ_240=y
```
